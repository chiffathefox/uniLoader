## configs/beyondlte_defconfig
```kconfig
CONFIG_UART_DEBUG=y
CONFIG_EXYNOS_9820=y
CONFIG_EXYNOS_S3C2410=y
CONFIG_SAMSUNG_BEYONDLTE=y
CONFIG_POSITION_INDEPENDENT=y
CONFIG_TEXT_BASE=0x80000000
CONFIG_PAYLOAD_ENTRY=0x10008000
CONFIG_RAMDISK_ENTRY=0xf0000000
```
